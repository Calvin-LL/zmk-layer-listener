## Kconfig
```kconfig
DT_COMPAT_ZMK_LAYER_LISTENERS := zmk,layer-listeners

config ZMK_LAYER_LISTENERS
    bool
    default $(dt_compat_enabled,$(DT_COMPAT_ZMK_LAYER_LISTENERS))
```

## dts/bindings/zmk,keycode-listeners.yaml
```yaml
# Copyright (c) 2025 The ZMK Contributors
# SPDX-License-Identifier: MIT

description: Keycode listeners

compatible: "zmk,keycode-listeners"

properties:
  tap-ms:
    type: int
    description: Time to wait (in milliseconds) between the press and release events on a triggered listener behavior binding.
    default: 5
  wait-ms:
    type: int
    description: The default time to wait (in milliseconds) before triggering the next listener behavior binding.
    default: 5

child-binding:
  description: "A keycode listener"
  properties:
    keycodes:
      type: array
      required: true
    layers:
      type: array
      default: [-1]
    bindings:
      type: phandle-array
      required: true
```

## dts/bindings/zmk,layer-listeners.yaml
```yaml
# Copyright (c) 2025 The ZMK Contributors
# SPDX-License-Identifier: MIT

description: Layer listeners

compatible: "zmk,layer-listeners"

properties:
  tap-ms:
    type: int
    description: Time to wait (in milliseconds) between the press and release events on a triggered listener behavior binding.
    default: 5
  wait-ms:
    type: int
    description: The default time to wait (in milliseconds) before triggering the next listener behavior binding.
    default: 5

child-binding:
  description: "A layer listener"
  properties: 
    layers:
      type: array
      required: true
    bindings:
      type: phandle-array
      required: true
```
